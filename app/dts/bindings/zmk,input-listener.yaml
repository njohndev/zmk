## app/dts/bindings/zmk,input-listener.yaml
```yaml
# Copyright (c) 2024 The ZMK Contributors
# SPDX-License-Identifier: MIT

description: |
  Listener to subscribe to input events and send HID updates after processing

compatible: "zmk,input-listener"

properties:
  device:
    type: phandle
    required: true
  input-processors:
    type: phandle-array
  xy-swap:
    type: boolean
  x-invert:
    type: boolean
  y-invert:
    type: boolean
  scale-multiplier:
    type: int
    default: 1
  scale-divisor:
    type: int
    default: 1

child-binding:
  description: "Listener overrides for certain layers"

  properties:
    layers:
      type: array
      required: true
    process-next:
      type: boolean
    input-processors:
      type: phandle-array
```

## app/module/dts/bindings/sensor/pimoroni,trackball_pim447.yaml
```yaml
# Copyright (c) 2021 The ZMK Contributors
# SPDX-License-Identifier: MIT

description: Trackball PIM447

compatible: "pimoroni,trackball_pim447"

properties:
  label:
    type: string
    required: true

  reg:
    type: int
    required: true

  move-factor:
    type: int
    required: false
    default: 1

  invert-move-x:
    type: boolean
    required: false

  invert-move-y:
    type: boolean
    required: false

  button:
    type: int
    required: false
    default: 0

  swap-axes:
    type: boolean
    required: false

  scroll-divisor:
    type: int
    required: false
    default: 2

  invert-scroll-x:
    type: boolean
    required: false

  invert-scroll-y:
    type: boolean
    required: false

  mode:
    type: int
    required: false
    default: 1
    enum:
      - 1
      - 2

  sensor-layer-behavior:
    type: phandle
    required: false
    description: >
      Phandle to a zmk,behavior-sensor-layer node to activate a layer when the sensor is active.
#  sensor-layer-trigger:
#    type: boolean
#    description: >
#      A boolean property to enable the sensor layer trigger.
```
